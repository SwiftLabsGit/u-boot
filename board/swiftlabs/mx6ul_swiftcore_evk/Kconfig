## board/swiftlabs/mx6ul_swiftcore_evk/Kconfig
```kconfig
if TARGET_MX6UL_SWIFTCORE_EVK

config SYS_BOARD
	default "mx6ul_swiftcore_evk"

config SYS_VENDOR
	default "swiftlabs"

config SYS_CONFIG_NAME
	default "mx6ul_swiftcore_evk"

endif
```

## board/swiftlabs/mx6ul_swiftcore_v1/Kconfig
```kconfig
if TARGET_MX6UL_SWIFTCORE_V1

config SYS_BOARD
	default "mx6ul_swiftcore_v1"

config SYS_VENDOR
	default "swiftlabs"

config SYS_CONFIG_NAME
	default "mx6ul_swiftcore_v1"

endif
```
